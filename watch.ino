#include "U8glib.h"
U8GLIB_SSD1306_128X64 u8g(U8G_I2C_OPT_NONE|U8G_I2C_OPT_DEV_0);

int sum = 0;
int sum1 = 0;
int h=10, m=30, s=0, hA, mA, sA, flag =0;
int buzz = 8;
int button = 7;
int next = 6;
int pre = 5;
int fwd = 9;
int a = 0;
int x = 0;
int t = 0;
int newSum = 0;
int i1 =0;
int back = 3;
int b = 1;
int o =1;
int da=0;
int dt=0;
int ti=0;
int blue = 0;
//CALENDER

const unsigned char PROGMEM calendar [] = {

0x00, 0x00, 0x00, 0x00, 0x00, 0x00, 0x00, 0x00, 0x00, 0x00, 0x00, 0x00, 0x00, 0x00, 0x00, 0x00,

0x00, 0x00, 0x00, 0x00, 0x00, 0x00, 0x00, 0x00, 0x00, 0x00, 0x00, 0x00, 0x00, 0x00, 0x00, 0x00,
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0x00, 0x00, 0x00, 0x00, 0x00, 0x00, 0x00, 0x00, 0x00, 0x00, 0x00, 0x00, 0x00, 0x00, 0x00, 0x00

};
//ALARM BIT MAP
const unsigned char PROGMEM alarm [] = {

0x00, 0x00, 0x00, 0x00, 0x00, 0x00, 0x00, 0x00, 0x00, 0x00, 0x00, 0x00, 0x00, 0x00, 0x00, 0x00,

0x00, 0x00, 0x00, 0x00, 0x00, 0x00, 0x00, 0x00, 0x00, 0x00, 0x00, 0x00, 0x00, 0x00, 0x00, 0x00,
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0x00, 0x00, 0x00, 0x00, 0x00, 0x00, 0x00, 0x00, 0x00, 0x00, 0x00, 0x00, 0x00, 0x00, 0x00, 0x00

};

//BLUETOOTH
const unsigned char PROGMEM bluetooth [] = {

0x00, 0x00, 0x00, 0x00, 0x00, 0x00, 0x00, 0x00, 0x00, 0x00, 0x00, 0x00, 0x00, 0x00, 0x00, 0x00,

0x00, 0x00, 0x00, 0x00, 0x00, 0x00, 0x00, 0x00, 0x00, 0x00, 0x00, 0x00, 0x00, 0x00, 0x00, 0x00,
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0x00, 0x00, 0x00, 0x00, 0x00, 0x00, 0x00, 0x00, 0x00, 0x00, 0x00, 0x00, 0x00, 0x00, 0x00, 0x00

};
const unsigned char PROGMEM steps [] = {

0x00, 0x00, 0x00, 0x00, 0x00, 0x00, 0x00, 0x00, 0x00, 0x00, 0x00, 0x00, 0x00, 0x00, 0x00, 0x00,

0x00, 0x00, 0x00, 0x00, 0x00, 0x00, 0x00, 0x00, 0x00, 0x00, 0x00, 0x00, 0x00, 0x00, 0x00, 0x00,
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0x00, 0x00, 0x00, 0x00, 0x00, 0x00, 0x00, 0x00, 0x00, 0x00, 0x00, 0x00, 0x00, 0x00, 0x00, 0x00

};
void box(void)
{
  u8g.drawLine(20,20,60,20);
  u8g.drawLine(60,20,60,60);
  u8g.drawLine(60,60,20,60);
  u8g.drawLine(20,60,20,20);
  u8g.drawLine(25,20,25,5);
  u8g.drawLine(55,20,55,5);
  u8g.drawLine(25,5,55,5);
}

void month(int index){
   u8g.setFont(u8g_font_unifont);
   const char *months[12] = {"JAN","FEB","MAR","APR","MAY","JUN","JUL","AUG","SEP","OCT","NOV","DEC"};
   u8g.drawStr(29,18,months[index]);
   
}
void day(int index)
{
  u8g.setFont(u8g_font_unifont);
  const char *days[7] = {"Sat","Sun","Mon","Tue","Wed","Thu","Fri"};
  u8g.drawStr(30,35,days[index]);
  
}
int y = 0;
void date(int index)
{
  const char *dates[30] = {"1","2","3","4","5","6","7","8","9","10","11","12","13","14","15","16","17","18","19","20","21","22","23","24","25","26","27","28","29","30"};
  u8g.setFont(u8g_font_unifont);
  u8g.drawStr(37,50,dates[index]);
  

}



//DIGITAL CLOCK


void get_info(void)
{
  if(s==60){ 
    s=0; 
    m=m+1; 
  } 
  if(m==60) 
  { 
    m=0; 
    h=h+1; 
    flag=flag+1; 
  } 
  if(h==13) 
  { 
    h=1; 
  }

  u8g.print(h);
  u8g.print(":");
  u8g.print(m);
  u8g.print(":");
  u8g.print(s);
  u8g.setPrintPos(90,20);
  }

void data_menu(int index)
{
  const unsigned char *data[3] = {calendar,alarm,steps};
  const char *dataName[3] = {"Calendar","Alarm","Pedometer"};
  u8g.setFont(u8g_font_unifont);
  u8g.drawBitmapP( 0, 0, 16, 64,data[index]);
  u8g.drawStr(50,40,dataName[index]);   
}

void inlet(int index)
{
  u8g.setFont(u8g_font_unifont);
  if(index == 0){
    displayTime();

    while(b==1)
    {
     int rd = digitalRead(fwd);
     int nxt = digitalRead(next);
     int ok = digitalRead(button);
     if( rd == 1){
       u8g.firstPage();
     do{
      if(da<7 && dt<31){
        box();
        month(3);
        date(dt);
        day(da);
        displayTime();
      }else if(da<=7){
        da=0;
      }
      else if(dt<=29){
        dt=0;
      } 
    }while(u8g.nextPage());
    da=da+1;
     dt=dt+1;
   }
   int brd = digitalRead(back);
   if( brd == 1){
       u8g.firstPage();
     do{
      if(da<7 && dt<31){
        box();
        month(3);
        date(dt);
        day(da);
        displayTime();}
      /*}else if(da<=7 && da >=0){
        da=0;
      }
      else if(dt<=29 && dt >=0){
        dt=0;
      } */
      if(da==0 && da<dt){
        da=6;
        da = da+1;
        u8g.firstPage();
        do{
          box();
          day(0);
          date(dt);
          month(3);
          displayTime();}while(u8g.nextPage());
      }
    }while(u8g.nextPage());
    da=da-1;
     dt=dt-1;
   }
 
  else if(ok == 1){
    u8g.firstPage();
    do{
     displayTime();
    box();
    day(2);
    date(5);
    month(2);
    }while(u8g.nextPage());
  }
  else if(nxt == 1){
  b=2;
} 
    }
  }

  if(index==1){
    drawBox();
   
    while(b == 1){
    int fwdButton = digitalRead(fwd); 
    int nextButton = digitalRead(next);
    int okButton = digitalRead(button);
    if(fwdButton == 1){
      drawBox();
      i1=i1+1;
    u8g.firstPage();
    do{
      if(i1>=0 && i1<=25){
        drawBox();
        updateBoxBack(sum1);
        updateBox(abs(i1-1));
      }else if(i1>=25){
        i1=1;
      }
    }while(u8g.nextPage());
    
  }
  int backButton = digitalRead(back);
    if (backButton == 1){
          drawBox();      
    sum1=sum1+5;
    u8g.firstPage();
    do{
      if(sum1>=0 && sum1<=60){
        drawBox();
        updateBox(abs(i1-1));
        updateBoxBack(sum1);
      }if(sum1>59){
        sum1=0;
      }
    }while(u8g.nextPage());
  }
  else if (okButton == 1){
    
    u8g.firstPage();do{
      displayTime();
      u8g.setPrintPos(20,20);
      u8g.print("hour:");
      u8g.setPrintPos(58,20);
      u8g.print(abs(i1-1));
      u8g.setPrintPos(20,35);
      u8g.print("mins:");
      u8g.setPrintPos(58,35);
      u8g.print(sum1);
      u8g.setPrintPos(20,62);
      u8g.print("ALARM SET");
      }while(u8g.nextPage());
      
    }
  else if(nextButton == 1){
    b=2;
  }
   }
  }
  if(index == 2)
  {
    int on = analogRead(fwd);
    int off = analogRead(back);
    if(on == 1)
    {
      analogWrite(blue,HIGH);
      u8g.firstPage();
      do{
        u8g.setPrintPos(20,45);
        u8g.print("BLUETOOTH ON");
      }while(u8g.nextPage());
    
    }
    else if(off == 1)
    {
      analogWrite(blue,LOW);
      u8g.firstPage();
      do{
        u8g.setPrintPos(20,45);
        u8g.print("BLUETOOTH Off");
      }while(u8g.nextPage());
    }
  }
  
}

int alarmBuzz(){
  if(i1-1==h && sum1==m){
    
   return 0;
  }
  else{
    return 1;
}
}


ISR(TIMER1_COMPA_vect)
{
  time();
}

void time()
{
  s=s+1;
  if(s==60){ 
    s=0; 
    m=m+1; 
  } 
  if(m==60) 
  { 
    m=0; 
    h=h+1; 
    flag=flag+1; 
  } 
  if(h==13) 
  { 
    h=1; 
  }
}


void displayTime()
{
   u8g.setPrintPos(80,15);
   u8g.print(h);
   u8g.print(":");
   u8g.print(m);
}

void drawBox(){
  u8g.setPrintPos(35,15);
  u8g.print("Hr");
  u8g.drawLine(20,20,60,20);
  u8g.drawLine(60,20,60,60);
  u8g.drawLine(60,60,20,60);
  u8g.drawLine(20,60,20,20);
 
  u8g.setPrintPos(80,15);
  u8g.print("Min");
  u8g.drawLine(70,20,110,20);
  u8g.drawLine(110,20,110,60);
  u8g.drawLine(110,60,70,60);
  u8g.drawLine(70,60,70,20);
}
void updateBox(int para){
  u8g.setFont(u8g_font_unifont);
  u8g.setPrintPos(33,40);
  u8g.print(para);
}
void updateBoxBack(int p){
  u8g.setFont(u8g_font_unifont);
  u8g.setPrintPos(78,40);
  u8g.print(p);
}

void setup() 
{
  Serial.begin(9600);  
  u8g.setFont(u8g_font_unifont);
  pinMode(button,INPUT);
  pinMode(next,INPUT);
  pinMode(blue,OUTPUT);
 pinMode(fwd,INPUT);
  pinMode(buzz,OUTPUT);
 pinMode(back,INPUT);
   
  cli();
  
  TCCR1A = 0;
  TCCR1B = 0;
  TCNT1  = 0;
  OCR1A = 15624;
  TCCR1B |= (1 << WGM12);
  TCCR1B |= (1 << CS12) | (1 << CS10);  
  TIMSK1 |= (1 << OCIE1A);
  sei();
}

  
void loop()
{
  int fwdsn = digitalRead(fwd);
  b=1;
  da =0;
  dt =0;
    if (digitalRead(next) == HIGH)
    {
      
      sum = sum+1;
      u8g.firstPage();
      if (sum>=0 && sum <5)
      {
      do{
        
        data_menu(sum-1);
         displayTime();
        
      }while(u8g.nextPage()); 
      s = ti;
      }  
    }   
 else if (digitalRead(button) == HIGH)
          {
                        
            u8g.firstPage();
            do{
                inlet(sum-1);
                  }while(u8g.nextPage());     
             s = ti;     
          }
   else if(digitalRead(button) == LOW && digitalRead(next) == LOW)
   {
     if(ti+20 == s)
     {
       u8g.firstPage();
       do{
       u8g.setPrintPos(45,44);
       u8g.print("   ");
       }while(u8g.nextPage());
     }
     else if(ti+5 == s)
     {
       u8g.firstPage();
       do{
         u8g.setPrintPos(45,44);
         displayTime();
         month(5);
         day(2);
         date(3);
         u8g.setPrintPos(80,30);
         u8g.print("ALARM");
         u8g.setPrintPos(85,48);
         u8g.print(abs(i1-1));
         u8g.setPrintPos(99,48);
         u8g.print(":");
         u8g.setPrintPos(109,48);
         u8g.print(sum1);
       }while(u8g.nextPage());
     }
     else if(ti+10 == s)
     {
       u8g.firstPage();
       do{
         u8g.setPrintPos(20,44);
         u8g.print("WHATSAPP SMS");
       }while(u8g.nextPage());
     }
      else if(ti+15 == s)
     {
       u8g.firstPage();
       do{
         u8g.setPrintPos(20,44);
         u8g.print("NORMAL SMS");
       }while(u8g.nextPage());
     }
     else if(ti+16 == s)
     {
       u8g.firstPage();
       do{
         u8g.setPrintPos(0,35);
         u8g.print("Have a nice day");
         u8g.setPrintPos(0,49);
          u8g.print("Mr.Atique");
       }while(u8g.nextPage());
     }
         
         
   }
       
  else if(sum>3){
    sum=0;}
  else if(digitalRead(fwd) == HIGH){
    digitalWrite(fwd,LOW);
  }
  else if(digitalRead(back) == HIGH){
    digitalWrite(back,LOW);
  }
  
  else if(alarmBuzz() == 0){
    u8g.firstPage();
    do{
      u8g.setPrintPos(20,45);
      u8g.print("snooz");
    }while(u8g.nextPage());
    digitalWrite(buzz,HIGH);
    
    delay(500);
    digitalWrite(buzz,LOW);
    delay(500);
  }  
else if(alarmBuzz()==1)
{
digitalWrite(buzz,LOW);
}  
}
